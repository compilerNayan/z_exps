## sdkconfig.defaults
```kconfig
CONFIG_COMPILER_CXX_EXCEPTIONS=y
CONFIG_COMPILER_CXX_EXCEPTIONS_EMG_POOL_SIZE=0

# Increase main task stack size (needed for TLS handshake)
CONFIG_ESP_MAIN_TASK_STACK_SIZE=12288

# Enable built-in CA certificate bundle
CONFIG_ESP_TLS_USE_CA_STORE=y
CONFIG_ESP_CRYPTO_TLS_SUPPORT_CA_BUNDLE=y
CONFIG_MBEDTLS_CERTIFICATE_BUNDLE=y
CONFIG_MBEDTLS_CERTIFICATE_BUNDLE_DEFAULT_FULL=y
CONFIG_MBEDTLS_CERTIFICATE_BUNDLE_CROSS_SIGNED_VERIFY=y
CONFIG_MBEDTLS_CHACHA20_C=y
CONFIG_MBEDTLS_CHACHAPOLY_C=y
CONFIG_MBEDTLS_SSL_PROTO_TLS1_3=y
CONFIG_MBEDTLS_SSL_TLS1_3_KEXM_EPHEMERAL=y
```
